## components/smartconfig_component/Kconfig
```kconfig
menu "SmartConfig Component Configuration"

    config SC_ENABLE_ESPTOUCH_V2
        bool "Enable ESPTOUCH V2 protocol support"
        default n
        help
            Enable ESPTOUCH V2 protocol for additional data transmission.

    config SC_TASK_STACK_SIZE
        int "SmartConfig task stack size"
        default 4096
        range 2048 8192
        help
            Stack size for SmartConfig task in bytes.

    config SC_TASK_PRIORITY
        int "SmartConfig task priority"
        default 3
        range 1 24
        help
            FreeRTOS task priority for SmartConfig.

    config SC_MAX_OBSERVERS
        int "Maximum number of status observers"
        default 3
        range 1 10
        help
            Maximum number of callback functions that can be registered.

    config SC_AUTO_SAVE_WIFI
        bool "Auto save WiFi credentials"
        default y
        help
            Automatically save WiFi credentials to NVS after successful connection.

    config SC_AUTO_RECONNECT
        bool "Auto reconnect on disconnect"
        default y
        help
            Automatically try to reconnect when WiFi disconnects.

    config SC_SET_AP_MAC
        bool "Set target AP MAC address"
        default y
        help
            Set BSSID of target AP for more reliable connection.

endmenu
```

## main/Kconfig.projbuild
```kconfig
menu "AlientekAiBox1 Version"

    config APP_VERSION_MAJOR
        int "Major version"
        range 0 999
        default 1
        help
            主版本号，不兼容的硬件/协议变更时递增

    config APP_VERSION_MINOR
        int "Minor version"
        range 0 999
        default 0
        help
            次版本号，新增功能时递增

    config APP_VERSION_PATCH
        int "Patch version"
        range 0 999
        default 0
        help
            修订号，修复 bug 时递增

endmenu
```
